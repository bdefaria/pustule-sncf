## conf/layer.conf
```bitbake
# We have a conf and classes directory, add to BBPATH
BBPATH .= ":${LAYERDIR}"

# We have recipes-* directories, add to BBFILES
BBFILES += "${LAYERDIR}/recipes-*/*/*.bb ${LAYERDIR}/recipes-*/*/*.bbappend"

BBFILE_COLLECTIONS += "meta-pustule"
BBFILE_PATTERN_meta-pustule = "^${LAYERDIR}/"
BBFILE_PRIORITY_meta-pustule = "6"

# Let us add layer-specific bbappends which are only applied when that
# layer is included in our configuration
BBFILES += "${@' '.join('${LAYERDIR}/%s/recipes*/*/*.bbappend' % layer \
               for layer in BBFILE_COLLECTIONS.split())}"
```

## conf/machine/panda.conf
```bitbake
SOC_FAMILY = "omap4"
require conf/machine/include/soc-family.inc

DEFAULTTUNE ?= "cortexa9thf-neon"
require conf/machine/include/tune-cortexa9.inc

PREFERRED_PROVIDER_virtual/kernel = "linux-yocto"
#PREFERRED_PROVIDER_virtual/bootloader = "u-boot-ti-staging"
#PREFERRED_PROVIDER_u-boot = "u-boot-ti-staging"

#PREFERRED_PROVIDER_virtual/xserver = "xserver-xorg"
#XSERVER = "xserver-xorg \
#           xserver-xorg-module-exa \
#           xf86-input-evdev \
#           xf86-video-omap"

# Increase this everytime you change something in the kernel
#MACHINE_KERNEL_PR = "r4"

KERNEL_IMAGETYPE = "zImage"
KERNEL_DEVICETREE = "omap4-panda-es.dtb"

#UBOOT_MACHINE = "omap4_panda_config"

#UBOOT_ENTRYPOINT = "0x80008000"
#UBOOT_LOADADDRESS = "0x80008000"

#EXTRA_IMAGEDEPENDS += "u-boot"

IMAGE_FSTYPES += "tar.gz"

SERIAL_CONSOLE = "115200 ttyO2"

MACHINE_EXTRA_RRECOMMENDS = " kernel-modules"
MACHINE_FEATURES = "wifi bluetooth alsa apm ext2 screen usbgadget usbhost vfat"
```
